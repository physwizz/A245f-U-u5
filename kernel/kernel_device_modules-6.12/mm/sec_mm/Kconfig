## kernel/kernel_device_modules-6.12/mm/sec_mm/Kconfig
```kconfig
menu "SEC Memory Management Options"

config SEC_MM
	tristate "Enable SEC MM"
	depends on ANDROID_VENDOR_HOOKS
	default m
	help
	  SEC memory management module.
	  With this feature enabled, system memory status and process lists
	  are printed in kernel log when the device goes low on file cache or
	  kernel panic events.
          This also supports tuning mm params via vendor hook.

config SEC_MM_DUMP_DMABUF_TASKS
	bool "Support for printing dmabuf usage information"
	depends on SEC_MM
	depends on !DMABUF_HEAPS_SAMSUNG_SYSTEM
	default y
	help
	  Print dmabuf usage information.

config SEC_MM_CUSTOMIZE_ZONE_PAGESET
	bool "use custom pcp policy"
	default y
	help
	  With this feature enabled, pcp batch/high will follow kernel v5.10
	  policy.

config MMAP_READAROUND_LIMIT
	int "Limit mmap readaround upperbound"
	default 16
	help
	  Inappropriate mmap readaround size can hurt device performance
	  during the sluggish situation. Add the hard upper-limit for
	  mmap readaround.

endmenu
```
