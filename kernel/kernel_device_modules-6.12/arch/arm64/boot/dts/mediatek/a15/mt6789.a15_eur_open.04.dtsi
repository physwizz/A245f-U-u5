/* 
 * Generated by Samsung 
 * If these files should be changed, then please make a sync with MTK
*/

#include "mt6789-a15_common.dtsi"
#include "mt6789-a15_camera.dtsi"

/*End of this file, DO NOT ADD ANYTHING HERE*/
